## build/conf/bblayers.conf
```bitbake
# POKY_BBLAYERS_CONF_VERSION is increased each time build/conf/bblayers.conf
# changes incompatibly
POKY_BBLAYERS_CONF_VERSION = "2"

BBPATH = "${TOPDIR}"
BBFILES ?= ""

BBLAYERS ?= " \
  /home/stephan/Documents/IB2/yocto/poky/meta \
  /home/stephan/Documents/IB2/yocto/poky/meta-poky \
  /home/stephan/Documents/IB2/yocto/poky/meta-yocto-bsp \
  /home/stephan/Documents/IB2/yocto/meta-raspberrypi \
  /home/stephan/Documents/IB2/yocto/meta-openembedded/meta-oe \
  /home/stephan/Documents/IB2/yocto/meta-openembedded/meta-python \
  /home/stephan/Documents/IB2/yocto/meta-openembedded/meta-networking \
  /home/stephan/Documents/IB2/yocto/meta-rauc \
  /home/stephan/Documents/IB2/yocto/meta-infusion-pump \
  "
```
